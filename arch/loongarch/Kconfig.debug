## net/net_hooks/Kconfig
```kconfig
# SPDX-License-Identifier: GPL-2.0-only
#
# Copyright (c) 2022 Huawei Device Co., Ltd.
#
# The Kconfig file is inserted when the "linux-5.10\net\" directory
# adds a separate warehouse module. The content of the Kconfig file
# of the new module is added to this file to avoid downloading the
# kernel repository separately. When the kernel repository is not downloaded,
# an error message is displayed indicating that the Kconfig file of the new
# module cannot be found.
#

# NewIP as module will cause a CRASH if you try to unload it
# net/newip
menuconfig NEWIP
	bool "The NewIP protocol"
	depends on INET
	default n
	help
	  Support for NewIP.

if NEWIP
config NEWIP_HOOKS
	bool "NewIP Hooks"
	depends on VENDOR_HOOKS && NEWIP
	default n
	help
	  Enable NewIP hooks implemented as tracepoints
	  Allow NewIP modules to attach to tracepoint "hooks" defined via
	  DECLARE_TRACE or DECLARE_HOOK

config NEWIP_FAST_KEEPALIVE
	bool "NewIP fast keepalive"
	default n
	help
	  Support for NewIP fast keepalive.

endif # NEWIP
```
