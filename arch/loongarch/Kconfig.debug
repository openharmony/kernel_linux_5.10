## arch/loongarch/Kconfig.debug
```kconfig
choice
	prompt "Choose kernel unwinder"
	default UNWINDER_PROLOGUE if KALLSYMS
	help
	  This determines which method will be used for unwinding kernel stack
	  traces for panics, oopses, bugs, warnings, perf, /proc/<pid>/stack,
	  livepatch, lockdep, and more.

config UNWINDER_GUESS
	bool "Guess unwinder"
	help
	  This option enables the "guess" unwinder for unwinding kernel stack
	  traces.  It scans the stack and reports every kernel text address it
	  finds.  Some of the addresses it reports may be incorrect.

config UNWINDER_PROLOGUE
	bool "Prologue unwinder"
	depends on KALLSYMS
	help
	  This option enables the "prologue" unwinder for unwinding kernel stack
	  traces.  It unwind the stack frame based on prologue code analyze.  Symbol
	  information is needed, at least the address and length of each function.
	  Some of the addresses it reports may be incorrect.

endchoice

config DEBUG_ZBOOT
	bool "Enable compressed kernel support debugging"
	depends on DEBUG_KERNEL && SYS_SUPPORTS_ZBOOT
	default n
	help
	  If you want to add compressed kernel support to a new board, and the
	  board supports uart16550 compatible serial port, please select
	  SYS_SUPPORTS_ZBOOT_UART16550 for your board and enable this option to
	  debug it.

	  If your board doesn't support uart16550 compatible serial port, you
	  can try to select SYS_SUPPORTS_ZBOOT and use the other methods to
	  debug it. for example, add a new serial port support just as
	  arch/loongarch/boot/compressed/uart-16550.c does.

	  After the compressed kernel support works, please disable this option
	  to reduce the kernel image size and speed up the booting procedure a
	  little.

config SPINLOCK_TEST
	tristate "Enable spinlock timing tests in debugfs"
	default n
	help
	  Add several files to the debugfs to test spinlock speed.
```

## drivers/accesstokenid/Kconfig
```kconfig
# SPDX-License-Identifier: GPL-2.0
config ACCESS_TOKENID
	bool "Access task's token"
	default n
```

## drivers/block/zram/zram_group/Kconfig
```kconfig
# SPDX-License-Identifier: GPL-2.0
config ZRAM_GROUP
	bool "Manage Zram objs with mem_cgroup"
	depends on ZRAM && MEMCG
	help
	  Manage Zram objs with mem_cgroup.

config ZRAM_GROUP_DEBUG
	bool "Debug info for zram group"
	depends on ZRAM_GROUP
	help
	  Debug info for ZRAM_GROUP.

config ZLIST_DEBUG
	bool "Debug info for zram group list"
	depends on ZRAM_GROUP
	help
	  Debug info for zram group list.

config ZRAM_GROUP_WRITEBACK
	bool "Write back grouped zram objs to Hyperhold driver"
	depends on ZRAM_GROUP && HYPERHOLD
	help
	  Write back grouped zram objs to hyperhold.
```

## drivers/dma-buf/Kconfig
```kconfig
# SPDX-License-Identifier: GPL-2.0-only
menu "DMABUF options"

config SYNC_FILE
	bool "Explicit Synchronization Framework"
	default n
	select DMA_SHARED_BUFFER
	help
	  The Sync File Framework adds explicit synchronization via
	  userspace. It enables send/receive 'struct dma_fence' objects to/from
	  userspace via Sync File fds for synchronization between drivers via
	  userspace components. It has been ported from Android.

	  The first and main user for this is graphics in which a fence is
	  associated with a buffer. When a job is submitted to the GPU a fence
	  is attached to the buffer and is transferred via userspace, using Sync
	  Files fds, to the DRM driver for example. More details at
	  Documentation/driver-api/sync_file.rst.

config SW_SYNC
	bool "Sync File Validation Framework"
	default n
	depends on SYNC_FILE
	depends on DEBUG_FS
	help
	  A sync object driver that uses a 32bit counter to coordinate
	  synchronization.  Useful when there is no hardware primitive backing
	  the synchronization.

	  WARNING: improper use of this can result in deadlocking kernel
	  drivers from userspace. Intended for test and debug only.

config UDMABUF
	bool "userspace dmabuf misc driver"
	default n
	depends on DMA_SHARED_BUFFER
	depends on MEMFD_CREATE || COMPILE_TEST
	help
	  A driver to let userspace turn memfd regions into dma-bufs.
	  Qemu can use this to create host dmabufs for guest framebuffers.

config DMABUF_MOVE_NOTIFY
	bool "Move notify between drivers (EXPERIMENTAL)"
	default n
	depends on DMA_SHARED_BUFFER
	help
	  Don't pin buffers if the dynamic DMA-buf interface is available on
	  both the exporter as well as the importer. This fixes a security
	  problem where userspace is able to pin unrestricted amounts of memory
	  through DMA-buf.
	  This is marked experimental because we don't yet have a consistent
	  execution context and memory management between drivers.

config DMABUF_SELFTESTS
	tristate "Selftests for the dma-buf interfaces"
	default n
	depends on DMA_SHARED_BUFFER

config DMABUF_PROCESS_INFO
	bool "Show dmabuf usage of all processes"
	default n
	depends on DMA_SHARED_BUFFER
	depends on PROC_FS || DEBUG_FS
	help
	  Choose this option to show dmabuf objects usage of all processes.
	  Firstly, with this option, when a process creates a dmabuf object,
	  its pid and task_comm will be recorded in the dmabuf.
	  Secondly, this option creates dma_buf/process_bufinfo file in
	  debugfs (if DEBUG_FS enabled) and process_dmabuf_info file in procfs
	  (if PROC_FS enabled) to show dmabuf objects usage of all processes.

menuconfig DMABUF_HEAPS
	bool "DMA-BUF Userland Memory Heaps"
	select DMA_SHARED_BUFFER
	help
	  Choose this option to enable the DMA-BUF userland memory heaps.
	  This options creates per heap chardevs in /dev/dma_heap/ which
	  allows userspace to allocate dma-bufs that can be shared
	  between drivers.

menuconfig DMABUF_SYSFS_STATS
	bool "DMA-BUF sysfs statistics"
	depends on DMA_SHARED_BUFFER
	help
	   Choose this option to enable DMA-BUF sysfs statistics
	   in location /sys/kernel/dmabuf/buffers.

	   /sys/kernel/dmabuf/buffers/<inode_number> will contain
	   statistics for the DMA-BUF with the unique inode number
	   <inode_number>.

source "drivers/dma-buf/heaps/Kconfig"

endmenu
```

## drivers/hck/Kconfig
```kconfig
# SPDX-License-Identifier: GPL-2.0-only
menu "Hck"

config HCK
	bool "Hck Drivers"
	help
	  Enable support for various drivers needed on the OpenHarmony Common Kernel

if HCK

config HCK_VENDOR_HOOKS
	bool "Hck Vendor Hooks"
	help
	  Enable vendor hooks implemented as tracepoints

	  Allow vendor modules to attach to tracepoint "hooks" defined via
	  DECLARE_HCK_HOOK DECLARE_HCK_RESTRICTED_HOOK

endif # if HCK

endmenu
```

## drivers/hooks/Kconfig
```kconfig
# SPDX-License-Identifier: GPL-2.0
menu "Vendor Hooks"

config VENDOR_HOOKS
	bool "Vendor Hooks"
	depends on TRACEPOINTS
	help
	  Enable vendor hooks implemented as tracepoints

	  Allow vendor modules to attach to tracepoint "hooks" defined via
	  DECLARE_TRACE or DECLARE_HOOK

config OHOS_VENDOR
	def_bool $(success,$(srctree)/scripts/ohos-check-dir.sh $(srctree)/vendor)

endmenu
```

## drivers/hyperhold/Kconfig
```kconfig
# SPDX-License-Identifier: GPL-2.0
config HYPERHOLD
	bool "Hyperhold driver"
	select HYPERHOLD_ZSWAPD
	select HYPERHOLD_MEMCG
	default n
	help
	  Hyperhold driver.

config HYPERHOLD_DEBUG
	bool "Debug info for Hyperhold driver"
	depends on HYPERHOLD
	help
	  Debug info for Hyperhold driver.
```

## drivers/staging/blackbox/Kconfig
```kconfig
# SPDX-License-Identifier: GPL-2.0
menu "Blackbox Options"

config BLACKBOX
	bool "Support for blackbox"
	select STORAGE if BLACKBOX_STORAGE_MATERIAL
	default y
	help
		The blackbox is a fault log collecting framework for registered modules
		of chips. When a fault occurs, blackbox will invoke the registered
		function to save the log and reset the module.

config BLACKBOX_LOG_ROOT_PATH
	string "root path of the blackbox log"
	depends on BLACKBOX
	help
		define the root path of the blackbox log

config BLACKBOX_LOG_PART_REPRESENTATIVE
	string "representative of the blackbox log part"
	depends on BLACKBOX
	help
		define the representative of the blackbox log part

config BLACKBOX_STORAGE_BY_MEMORY
	tristate "blackbox fault log storage by memory directly"
	depends on BLACKBOX
	select STORAGE_BY_MEMORY
	help
		This option enables saving fault logs with memory by blackbox when a
		panic occurs. It depends on supporting warm reset and disabling erase
		ddr when warm reset.

config BLACKBOX_USE_PSTORE_BLK_DEBUG
	bool "blackbox use pstore blk for debug"
	depends on BLACKBOX
	default n
	help
		If Y, this enables pstore blk for blackbox.

config BLACKBOX_STORAGE_BY_PSTORE_BLK
	tristate "blackbox fault log storage by pstore blk"
	depends on BLACKBOX
	depends on PSTORE_BLK
	depends on PSTORE_BLACKBOX
	select STORAGE_BY_PSTORE_BLK
	help
		This option enables saving fault logs with pstore blk by blackbox when a
		panic occurs. It depends on supporting pstore blk. Especially, flash
		driver's panic_write implementation is needed. Othersize, if a panic
		happen, then fault log can not be saved.

config BLACKBOX_STORAGE_BY_PSTORE_RAM
	tristate "blackbox fault log storage by pstore ram"
	depends on BLACKBOX
	depends on PSTORE_RAM
	depends on PSTORE_BLACKBOX
	select STORAGE_BY_PSTORE_RAM
	help
		This option enables saving fault logs with pstore ram by blackbox when a
		panic occurs. It depends on supporting pstore ram.

config BLACKBOX_STORAGE_BY_RAW_PARTITION
	tristate "blackbox fault log storage by RAW partition"
	depends on BLACKBOX
	select STORAGE_BY_RAW_PARTITION
	help
		This option enables saving fault logs with RAW partition by blackbox when a
		panic occurs. It depends on reserving partition for blackbox.

config BLACKBOX_STORAGE_MATERIAL
	def_bool y
	depends on BLACKBOX
	depends on BLACKBOX_STORAGE_BY_MEMORY || BLACKBOX_STORAGE_BY_PSTORE_BLK || \
		BLACKBOX_STORAGE_BY_PSTORE_RAM || BLACKBOX_STORAGE_BY_RAW_PARTITION

choice
	prompt "Default storage material for fault log when a panic occurs."
	depends on BLACKBOX_STORAGE_MATERIAL
	help
		This option choose the default fault log material for blackbox when a
		panic occurs.

		The default materail is ram directly. It's easy, but not work offen.

	config DEF_BLACKBOX_STORAGE_BY_MEMORY
		bool "memory" if BLACKBOX_STORAGE_BY_MEMORY

	config DEF_BLACKBOX_STORAGE_BY_PSTORE_BLK
		bool "pstore_blk" if BLACKBOX_STORAGE_BY_PSTORE_BLK

	config DEF_BLACKBOX_STORAGE_BY_PSTORE_RAM
		bool "pstore_ram" if BLACKBOX_STORAGE_BY_PSTORE_RAM

	config DEF_BLACKBOX_STORAGE_BY_RAW_PARTITION
		bool "raw_partition" if BLACKBOX_STORAGE_BY_RAW_PARTITION

endchoice

config DEF_BLACKBOX_STORAGE
	string
	depends on BLACKBOX_STORAGE_MATERIAL
	default "memory" if DEF_BLACKBOX_STORAGE_BY_MEMORY
	default "pstore_blk" if DEF_BLACKBOX_STORAGE_BY_PSTORE_BLK
	default "pstore_ram" if DEF_BLACKBOX_STORAGE_BY_PSTORE_RAM
	default "raw_partition" if DEF_BLACKBOX_STORAGE_BY_RAW_PARTITION

endmenu
```

## drivers/staging/hilog/Kconfig
```kconfig
#
# Sensor device configuration
#

config HILOG
	tristate "Hilog support"
	default n
	help
	  hilog buffer manager.

	  Hilog is a simple log manager for OpenHarmonyOS.
	  log string write to /dev/hilog, and the hilog driver copy it
	  to the ring buffer. Ring buffer can be read from userspace.

	  If unsure, say N.

if HILOG
config HI_LOG_BUFFER_SIZE
	int "hi log buffer size"
	default "2048"
endif
```

## drivers/staging/zerohung/Kconfig
```kconfig
# SPDX-License-Identifier: GPL-2.0
config DFX_ZEROHUNG
	bool "zerohung driver"
	default n
	depends on HISYSEVENT
	help
	  This feature support to catch hung log
```

## fs/epfs/Kconfig
```kconfig
# SPDX-License-Identifier: GPL-2.0
config EPFS
	bool "Enhanced Proxy File System support"
	depends on TMPFS
	help
	  Enhanced Proxy File System support. If unsure, say N.

config EPFS_DEBUG
	bool "Debug message of Enhanced Proxy File System"
	depends on EPFS
	help
	  Enhanced Proxy File System debug support.
```

## fs/hmdfs/Kconfig
```kconfig
config HMDFS_FS
	tristate "HMDFS filesystem support"
	help
	  HMDFS is an overlay file system. Relying on the underlying file system,
	  under the premise of networking, file exchanges across devices can be
	  realized. Device view and merge view are provided. In the device view,
	  the shared directories of the corresponding devices are provided under
	  different device directories; in the merge view, acollection of shared
	  files of all devices is provided.

config HMDFS_FS_PERMISSION
	bool "HMDFS application permission management"
	depends on HMDFS_FS
	help
	  HMDFS provides cross-device file and directory sharing. Only the same
	  application can access the files and directories under the corresponding
	  package directory. it provides management and control of access
	  permissions.

	  If unsure, say N.

config HMDFS_FS_ENCRYPTION
	bool "HMDFS message encryption"
	depends on HMDFS_FS && TLS
	help
	  HMDFS provides cross-device file and directory sharing by sending and
	  receiving network messages. To ensure data security, TLS encryption is
	  provided.

	  If you want to improve performance, say N.

config HMDFS_FS_DEBUG
	bool "HMDFS debug log"
	depends on HMDFS_FS
	help
	  HMDFS print a lot of logs, but many of them are debugging information,
	  which is actually unnecessary during operation. If there is a problem,
	  it works.

	  If unsure, say N.
```

## fs/sharefs/Kconfig
```kconfig
config SHARE_FS
	tristate "SHAREFS filesystem support"
	help
	  SHAREFS is an overlay file system.SHAREFS is used for file sharing
	  between applications. Sharefs manages permissions through different
	  permissions for reading and writing directories.

config SHAREFS_SUPPORT_OVERRIDE
	bool "Sharefs: support override "
	depends on SHARE_FS
	default n
	help
	  This is the switch of override feature on sharefs file system. 
	  If the device type is 2in1, it shoule be set y.

config SHAREFS_SUPPORT_WRITE
	bool "Sharefs: support write operations"
	depends on SHARE_FS
	depends on SHAREFS_SUPPORT_OVERRIDE
	default n
	help
	  This is the switch of write operation on sharefs file system. 
	  If the device type is 2in1 and writing files is needed,
	  it shoule be set y.
```

## kernel/sched/rtg/Kconfig
```kconfig
menu "Related Thread Group"

config SCHED_RTG
	bool "Related Thread Group"
	depends on SCHED_WALT
	default n
	help
	  Set related threads into a group.

config SCHED_RTG_DEBUG
	bool "Related Thread Group DebugFS"
	depends on SCHED_RTG
	default n
	help
	  If set, debug node will show rtg threads

config SCHED_RTG_CGROUP
	bool "enable DEFAULT_CGROUP_COLOC RTG"
	depends on SCHED_RTG
	default n
	help
	  If set, support for adding the tasks which belong to
	  co-located cgroup to DEFAULT_CGROUP_COLOC RTG.

config SCHED_RTG_FRAME
	bool "Frame-based Related Thread Group"
	depends on SCHED_RTG
	default n
	help
	 Support frame-based related thread group scheduling.
	 If set, you can set the task to RTG and kernel will
	 statistic the load per frame.

config SCHED_RTG_RT_THREAD_LIMIT
	bool "Limit the number of RT threads in groups"
	depends on SCHED_RTG_FRAME
	default n
	help
	  If set, limit the number of RT threads in frame RTG.

config SCHED_RTG_AUTHORITY
	bool "Related Thread Group authority control"
	depends on SCHED_RTG
	default n
	help
	 Support authority for RTG-related operations. If set,
	 only thread authorized can do RTG-related operations.

config SCHED_RTG_QOS
	bool "Related Thread Group authority control"
	depends on SCHED_RTG
	depends on SCHED_RTG_AUTHORITY
	default n
	help
	 Introduce qos support for thread. If set, thread can
	 apply kernel qos for better cpu time supply or lower
	 latency.
endmenu
```
